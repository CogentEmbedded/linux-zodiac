## Documentation/devicetree/bindings/input/rmi4/rmi_2d_sensor.txt
```
Synaptics RMI4 2D Sensor Device Binding

The Synaptics RMI4 core is able to support RMI4 devices using differnet
transports and differnet functions. This file describes the device tree
bindings for devices which contain 2D sensors using Function 11 or
Function 12. Complete documentation for transports and other functions
can be found in:
Documentation/devicetree/bindings/input/rmi4.

RMI4 Function 11 and Function 12 are for 2D touch position sensing.
Additional documentation for F11 can be found at:
http://www.synaptics.com/sites/default/files/511-000136-01-Rev-E-RMI4-Interfacing-Guide.pdf

Optional Properties:
- syna,swap-axes: Swap X and Y positions when reporting (boolean).
- syna,flip-x: Reverse the direction of X (boolean).
- syna,flip-y: Reverse the direction of Y (boolean).
- syna,clip-x-low: Sets a minimum value for X.
- syna,clip-y-low: Sets a minimum value for Y.
- syna,clip-x-high: Sets a maximum value for X.
- syna,clip-y-high: Sets a maximum value for Y.
- syna,offset-x: Add an offset to X.
- syna,offset_y: Add an offset to Y.
- syna,delta-x-threshold: Set the minimum distance on the X axis required
				to generate an interrupt in reduced reporting
				mode.
- syna,delta-y-threshold: Set the minimum distance on the Y axis required
				to generate an interrupt in reduced reporting
				mode.
- syna,type-a: Report type A multitouch events.
- syna,sensor-type: Set the sensor type. 1 for touchscreen 2 for touchpad.
- syna,x-mm: The length in millimeters of the X axis.
- syna,y-mm: The length in millimeters of the Y axis.
- syna,disable-report-mask: Mask for disabling posiiton reporting. Used to
				disable reporing absolute position data.
- syna,rezero-wait: Time in miliseconds to wait after issuing a rezero
				command.


Example of a RMI4 I2C device with F11:
Example:
	&i2c1 {
		rmi-i2c-dev@2c {
			compatible = "syna,rmi-i2c";

			...

			rmi-f11@11 {
				reg = <0x11>;
				syna,flip-y;
				syna,sensor-type = <2>;
			};
		};
	};
```

## Documentation/devicetree/bindings/input/rmi4/rmi_i2c.txt
```
Synaptics RMI4 I2C Device Binding

The Synaptics RMI4 core is able to support RMI4 devices using differnet
transports and differnet functions. This file describes the device tree
bindings for devices using the I2C tranport driver. Complete documentation
for other transports and functions cen be found ini
Documentation/devicetree/bindings/input/rmi4.

Required Properties:
- compatible: syna,rmi-i2c
- reg: I2C address
- #address-cells: Set to 1 to indicate that the function child nodes
		    consist of only on uint32 value.
- #size-cells: Set to 0 to indicate that the function child nodes do not
		have a size property.

Optional Properties:
- interrupts: interrupt which the rmi device is connected to.
- interrupt-parent: The interrupt controller.
See Documentation/devicetree/bindings/interrupt-controller/interrupts.txt

- syna,reset-delay-ms: The number of milliseconds to wait after resetting the
			device.

Function Parameters:
Parameters specific to RMI functions are contained in child nodes of the rmi device
 node. Documentation for the parameters of each function can be found in:
Documentation/devicetree/bindings/input/rmi4/rmi_f*.txt.



Example:
	&i2c1 {
		rmi-i2c-dev@2c {
			compatible = "syna,rmi-i2c";
			reg = <0x2c>;
			#address-cells = <1>;
			#size-cells = <0>;
			interrupt-parent = <&gpio>;
			interrupts = <4 2>;

			rmi-f01@1 {
				reg = <0x1>;
				syna,nosleep-mode = <1>;
			};

			rmi-f11@11 {
				reg = <0x11>;
				syna,flip-y;
				syna,sensor-type = <2>;
			};
		};
	};
```

## Documentation/devicetree/bindings/input/rmi4/rmi_spi.txt
```
Synaptics RMI4 SPI Device Binding

The Synaptics RMI4 core is able to support RMI4 devices using differnet
transports and differnet functions. This file describes the device tree
bindings for devices using the SPI tranport driver. Complete documentation
for other transports and functions cen be found ini
Documentation/devicetree/bindings/input/rmi4.

Required Properties:
- compatible: syna,rmi-spi
- reg: Chip select address for the device
- #address-cells: Set to 1 to indicate that the function child nodes
		    consist of only on uint32 value.
- #size-cells: Set to 0 to indicate that the function child nodes do not
		have a size property.

Optional Properties:
- interrupts: interrupt which the rmi device is connected to.
- interrupt-parent: The interrupt controller.
See Documentation/devicetree/bindings/interrupt-controller/interrupts.txt

- syna,spi-read-delay: millisecond delay between read byte transfers.
- syna,spi-write-delay: millisecond delay between write byte transfers.

Function Parameters:
Parameters specific to RMI functions are contained in child nodes of the rmi device
 node. Documentation for the parameters of each function can be found in:
Documentation/devicetree/bindings/input/rmi4/rmi_f*.txt.



Example:
	spi@7000d800 {
		rmi-spi-dev@0 {
			compatible = "syna,rmi-spi";
			reg = <0x0>;
			#address-cells = <1>;
			#size-cells = <0>;
			spi-max-frequency = <4000000>;
			spi-cpha;
			spi-cpol;
			interrupt-parent = <&gpio>;
			interrupts = <TEGRA_GPIO(K, 2) 0x2>;
			syna,spi-read-delay = <30>;

			rmi-f01@1 {
				reg = <0x1>;
				syna,nosleep-mode = <1>;
			};

			rmi-f11@11 {
				reg = <0x11>;
				syna,flip-y;
				syna,sensor-type = <2>;
			};
		};
	};
```

## Documentation/devicetree/bindings/mfd/zii-pic.txt
```
Zodiac Inflight Infotainment supervisory PIC controller family

Supervisory PIC controller is connected to application processor via
dedicated UART and implements following features:
 - HW reset
 - watchdog
 - LEDs
 - LCD backlight
 - EEPROM(s)
 - external button(s)
 - sensors (voltage, temperature, current, orientation, etc)
 - Boot source selection

Required properties:
- compatible - should contain:
 * "zii,pic-rdu" - for RDU HW variant
 * "zii,pic-niu" - for NIU HW variant
 * "zii,pic-mezz" - for MEZZ HW variant
 * "zii,pic-esb" - for ESB HW variant

- current-speed - UART line speed

Sub-devices:
 - EEPROMs
   * compatible:
      = "zii,pic-main-eeprom"
      = "zii,pic-dds-eeprom"
   * address and size cells to describe EEPROM layout for NVMEM
 - Watchdog
   * compatible:
     = "zii,pic-watchdog"
 - HWMON
   * compatible:
     = "zii,pic-hwmon"
   * sensors:
     =	"28V", "12V", "5V", "3V3", "TEMPERATURE", "TEMPERATURE_2", "BACKLIGHT_CURRENT"


Example:

&uart3 {
        pinctrl-names = "default";
        pinctrl-0 = <&pinctrl_uart3>;
        status = "okay";
        pic {
                compatible = "zii,pic-rdu";
                current-speed = <38400>;
                status = "okay";

                main_eeprom {
                        compatible = "zii,pic-main-eeprom";
                        #address-cells = <1>;
                        #size-cells = <1>;
                        status = "okay";

                        eeprom_format: eeprom-format@0 {
                                reg = <0x00 2>;
                        };
                        wdt_timeout: wdt-timeout@81 {
                                reg = <0x81 2>;
                        };
                        wdt_rmi: wdt-rmi@84 {
                                reg = <0x84 2>;
                        };
                        max_failed_boots: max-failed-boots@8E {
                                reg = <0x8E 2>;
                        };
                };

                dds_eeprom {
                        compatible = "zii,pic-dds-eeprom";
                        #address-cells = <1>;
                        #size-cells = <1>;
                        status = "okay";
                };

                watchdog {
                        compatible = "zii,pic-watchdog";
                        status = "okay";
                        nvmem-cells = <&wdt_rmi
                                        &wdt_timeout>;

                        nvmem-cell-names = "wdt_rmi",
                                        "wdt_timeout";
                };

                hwmon {
                        compatible = "zii,pic-hwmon";
                        sensors = "28V",
                                "TEMPERATURE",
                                "TEMPERATURE_2",
                                "BACKLIGHT_CURRENT";
                        status = "okay";
                };
        };
};
```

## drivers/input/rmi4/Kconfig
```kconfig
#
# RMI4 configuration
#
config RMI4_CORE
	tristate "Synaptics RMI4 bus support"
	help
	  Say Y here if you want to support the Synaptics RMI4 bus.  This is
	  required for all RMI4 device support.

	  If unsure, say Y.

	  This feature is not currently available as a loadable module.

config RMI4_DEBUG
	bool "RMI4 Debugging"
	depends on RMI4_CORE
	select DEBUG_FS
	help
	  Say Y here to enable debug feature in the RMI4 driver.

	  Note that the RMI4 driver debug features can generate a lot of
	  output (potentially clogging up your dmesg output) and generally
	  slow down driver operation.  It's recommended to enable them only
	  if you are actively developing/debugging RMI4 features.

	  If unsure, say N.

config RMI4_I2C
	tristate "RMI4 I2C Support"
	depends on RMI4_CORE && I2C
	help
	  Say Y here if you want to support RMI4 devices connected to an I2C
	  bus.

	  If unsure, say Y.

	  This feature is not currently available as a loadable module.
```

## drivers/misc/zii/Kconfig
```kconfig
#
# ZII_MX6_PLATFORM_INFO
#

menuconfig ZII_MX6_PLATFORM_INFO
	tristate "Zodiac Inflight Innovation MX6 Platform Info"
	depends on PROC_FS
	default n
	help
	  This option enables support for Zodiac Inflight Innovation MX6 Platform Info.

	  If you are not sure, say N here.

menuconfig ZII_VF6XX_PLATFORM_INFO
	tristate "Zodiac Inflight Innovation VF6XX Platform Info"
	depends on PROC_FS
	default n
	help
	  This option enables support for Zodiac Inflight Innovation VF6XX Platform Info.

	  If you are not sure, say N here.
```

## drivers/platform/rave/Kconfig
```kconfig
#
# Platform support for Zodiac RAVE hardware
#

menuconfig RAVE_PLATFORMS
	bool "Platform support for Zodiac RAVE hardware"
	depends on SERIAL_DEV_BUS && SERIAL_DEV_CTRL_TTYPORT
	help
	  Say Y here to get to see options for platform support for
	  various devices present in RAVE hardware. This option alone
	  does not add any kernel code.

	  If you say N, all options in this submenu will be skipped
	  and disabled.

if RAVE_PLATFORMS

config RAVE_SP_CORE
	tristate "RAVE SP MCU core driver"
	select MFD_CORE
	select CRC_CCITT
	help
	  Select this to get support for the Supervisory Processor
	  device found on several devices in RAVE line of hardware.

endif
```

## drivers/tty/serial/slave/Kconfig
```kconfig
menuconfig UART_SLAVE
	bool "UART slave devices"
	depends on OF
	help
	 Devices which attach via a uart, but need extra
	 driver support for power management etc.
```
